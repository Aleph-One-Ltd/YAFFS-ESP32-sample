## components/yaffs/Kconfig
```kconfig
menu "YAFFS Filesystem"

    config YAFFS_ENABLE_TRACE
        bool "Enable YAFFS trace output"
        default n
        help
            Enable trace messages for YAFFS debugging.
            This can produce significant output and should only
            be enabled when troubleshooting filesystem issues.

endmenu
```

## main/Kconfig.projbuild
```kconfig
menu "W25N YAFFS Driver"

    config W25N_SPI_MOSI_GPIO
        int "W25N MOSI GPIO"
        range -1 48
        default 23 if IDF_TARGET_ESP32
        default 11 if IDF_TARGET_ESP32S3
        default 11
        help
            GPIO connected to W25N DI / MOSI.

    config W25N_SPI_MISO_GPIO
        int "W25N MISO GPIO"
        range -1 48
        default 19 if IDF_TARGET_ESP32
        default 13 if IDF_TARGET_ESP32S3
        default 13
        help
            GPIO connected to W25N DO / MISO.

    config W25N_SPI_SCLK_GPIO
        int "W25N SCLK GPIO"
        range -1 48
        default 18 if IDF_TARGET_ESP32
        default 12 if IDF_TARGET_ESP32S3
        default 12
        help
            GPIO connected to W25N CLK / SCLK.

    config W25N_SPI_CS0_GPIO
        int "W25N chip 0 CS GPIO"
        range -1 48
        default 5 if IDF_TARGET_ESP32
        default 10 if IDF_TARGET_ESP32S3
        default 10
        help
            GPIO used as chip select for the first W25N device.

    config W25N_SPI_CS1_GPIO
        int "W25N chip 1 CS GPIO"
        range -1 48
        default 17 if IDF_TARGET_ESP32
        default 15 if IDF_TARGET_ESP32S3
        default 15
        help
            GPIO used as chip select for the second W25N device.

    config W25N_SPI_WP_GPIO
        int "W25N WP GPIO"
        range -1 48
        default 16 if IDF_TARGET_ESP32
        default 14 if IDF_TARGET_ESP32S3
        default 14
        help
            GPIO driving the W25N WP pin high. Set to -1 if WP is tied high
            externally and not connected to the ESP.

    config W25N_SPI_HOLD_GPIO
        int "W25N HOLD GPIO"
        range -1 48
        default 15 if IDF_TARGET_ESP32
        default 9 if IDF_TARGET_ESP32S3
        default 9
        help
            GPIO driving the W25N HOLD pin high. Set to -1 if HOLD is tied high
            externally and not connected to the ESP.

endmenu
```

## sdkconfig.defaults
```kconfig
# Increase main task stack size for YAFFS operations
CONFIG_ESP_MAIN_TASK_STACK_SIZE=16384
CONFIG_W25N_SPI_MOSI_GPIO=11
CONFIG_W25N_SPI_MISO_GPIO=13
CONFIG_W25N_SPI_SCLK_GPIO=12
CONFIG_W25N_SPI_CS0_GPIO=10
CONFIG_W25N_SPI_CS1_GPIO=15
CONFIG_W25N_SPI_WP_GPIO=14
CONFIG_W25N_SPI_HOLD_GPIO=9
```
